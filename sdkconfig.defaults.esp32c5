## sdkconfig.defaults.esp32c5
```kconfig
CONFIG_ESPTOOLPY_FLASHSIZE_8MB=y
CONFIG_ESPTOOLPY_FLASHMODE_QIO=y
CONFIG_PARTITION_TABLE_CUSTOM_FILENAME="partitions_8M.csv"

CONFIG_USE_WAKENET=n
CONFIG_USE_MULTINET=n
```
